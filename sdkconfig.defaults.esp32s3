## sdkconfig.defaults.esp32s3
```kconfig
CONFIG_IDF_CMAKE=y
CONFIG_IDF_TARGET_ARCH_XTENSA=y
CONFIG_IDF_TARGET="esp32s3"
CONFIG_IDF_TARGET_ESP32S3=y
CONFIG_IDF_FIRMWARE_CHIP_ID=0x0009

#
# Audio HAL
#
CONFIG_AUDIO_BOARD_CUSTOM=y
CONFIG_CUSTOM_BOARD_PATH="/main"
CONFIG_BT_BTC_TASK_STACK_SIZE=8192

#
# CPU
#
CONFIG_ESP_DEFAULT_CPU_FREQ_MHZ_240=y
CONFIG_ESP_DEFAULT_CPU_FREQ_MHZ=240
```
